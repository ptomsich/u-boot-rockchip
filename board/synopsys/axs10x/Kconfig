## board/synopsys/axs10x/Kconfig
```kconfig
if TARGET_AXS101 || TARGET_AXS103

config SYS_BOARD
	default "axs10x"

config SYS_VENDOR
	default "synopsys"

config SYS_CONFIG_NAME
	default "axs10x"

config CMD_NAND
        select BOUNCE_BUFFER if TARGET_AXS101 || TARGET_AXS103

endif
```
